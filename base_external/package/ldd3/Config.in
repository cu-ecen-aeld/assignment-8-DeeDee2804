## base_external/package/ldd3/Config.in
```kconfig
config BR2_PACKAGE_LDD3
	bool "ldd3"
	help
	  Includes the misc-modules and scull components on qemu target.
	  Used to understand how to build these subdirectories with the MODULE_SUBDIRS option.
```
